## conf/layer.conf
```bitbake
# We have a conf and classes directory, append to BBPATH
BBPATH .= ":${LAYERDIR}"

# We have a recipes directory, add to BBFILES
BBFILES += "${LAYERDIR}/recipes-*/*.bb ${LAYERDIR}/recipes-*/*.bbappend"

BBFILE_COLLECTIONS += "bb-cluster-layer"
BBFILE_PATTERN_bb-cluster-layer := "^${LAYERDIR}/"
BBFILE_PRIORITY_bb-cluster-layer = "6"
```
